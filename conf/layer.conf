## conf/layer.conf
```bitbake
BBPATH := "${BBPATH}:${LAYERDIR}" 
BBFILES := "${BBFILES} ${LAYERDIR}/recipes-*/*/*.bb ${LAYERDIR}/recipes-*/*/*.bbappend" 
BBFILE_COLLECTIONS += "phone"
BBFILE_PATTERN_phone := "^${LAYERDIR}/" 
BBFILE_PRIORITY_phone := "5"

LICENSE_FLAGS_WHITELIST="commercial_libav"
```
